## zmk-config/boards/shields/little-wing/Kconfig.defconfig
```kconfig
if SHIELD_LITTLE_WING_LEFT

# Name must be less than 16 characters long!
config ZMK_KEYBOARD_NAME
    default "Little Wing"

config ZMK_SPLIT_ROLE_CENTRAL
    default y

endif

if SHIELD_LITTLE_WING_LEFT || SHIELD_LITTLE_WING_RIGHT

config ZMK_SPLIT
    default y

endif
```

## zmk-config/boards/shields/little_wing/Kconfig.defconfig
```kconfig
if SHIELD_LITTLE_WING_RIGHT

# Name must be less than 16 characters long!
config ZMK_KEYBOARD_NAME
    default "Little Wing"

config ZMK_SPLIT_ROLE_CENTRAL
    default y

endif

if SHIELD_LITTLE_WING_LEFT || SHIELD_LITTLE_WING_RIGHT

config ZMK_SPLIT
    default y

if ZMK_DISPLAY

config I2C
    default n

config SSD1306
    default n

endif # ZMK_DISPLAY

endif
```

## zmk-config/boards/shields/little_wing/Kconfig.shield
```kconfig
# No whitespace after the comma or in your part name!
config SHIELD_LITTLE_WING_LEFT
    def_bool $(shields_list_contains,little_wing_left)

# No whitespace after the comma or in your part name!
config SHIELD_LITTLE_WING_RIGHT
    def_bool $(shields_list_contains,little_wing_right)
```

## zmk-config/config/west.yml
```yaml
manifest:
  remotes:
    - name: zmkfirmware
      url-base: https://github.com/petejohanson
    - name: pmw3610
      url-base: https://github.com/kaievns
    - name: mouse-behaviours
      url-base: https://github.com/kaievns

  projects:
    - name: zmk
      remote: zmkfirmware
      revision: feat/pointers-with-input-processors
      import: app/west.yml
    - name: zmk-pmw3610-driver
      remote: pmw3610
      revision: main
    - name: input-shaping
      remote: zmk-mouse-behaviours
      revision: main
  self:
    path: config
```
